#include <behaviors.dtsi>
#include <dt-bindings/zmk/keys.h>
#include <dt-bindings/zmk/bt.h>

/ {
    keymap{
        compatible = "zmk, keymap";

        default_layer {
            bindings = <
                &kp C_VOL_UP    &kp C_PP    &mo 1
                &kp K_VOL_DN    &kp C_NEXT  &kp C_PREV
            >;
        };

        bt_layer {
            bindings = <
                &bt BT_CLR          &bootlaoder         &none
                &bt BT_SEL0         &bt BT_SEL 1        &bt BT_SEL 2
            >;
        };
    };
};